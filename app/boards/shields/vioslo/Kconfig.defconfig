## app/boards/shields/vioslo/Kconfig.defconfig
```kconfig
if SHIELD_VIOSLO_LEFT

config ZMK_KEYBOARD_NAME
    default "Nowid Left"

config ZMK_SPLIT_BLE_ROLE_CENTRAL
    default y

endif

if SHIELD_VIOSLO_RIGHT

config ZMK_KEYBOARD_NAME
    default "Nowid right"

endif

if SHIELD_VIOSLO_LEFT || SHIELD_VIOSLO_RIGHT

config ZMK_SPLIT
    default y

endif
```

## app/boards/shields/vioslo/Kconfig.shield
```kconfig
config SHIELD_VIOSLO_LEFT
    def_bool $(shields_list_contains,vioslo_left)

config SHIELD_VIOSLO_RIGHT
    def_bool $(shields_list_contains,vioslo_right)
```

## app/boards/shields/viosuo/Kconfig.defconfig
```kconfig
if SHIELD_VIOSLO_LEFT

config ZMK_KEYBOARD_NAME
    default "Viosuo Left"

config ZMK_SPLIT_BLE_ROLE_CENTRAL
    default y

endif

if SHIELD_VIOSLO_RIGHT

config ZMK_KEYBOARD_NAME
    default "Viosuo right"

endif

if SHIELD_VIOSLO_LEFT || SHIELD_VIOSLO_RIGHT

config ZMK_SPLIT
    default y

endif
```

## app/boards/shields/viosuo/Kconfig.shield
```kconfig
config SHIELD_VIOSLO_LEFT
    def_bool $(shields_list_contains,viosuo_left)

config SHIELD_VIOSLO_RIGHT
    def_bool $(shields_list_contains,viosuo_right)
```
